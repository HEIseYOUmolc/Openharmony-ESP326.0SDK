## Kconfig
```kconfig
mainmenu "OpenHarmony ESP32 Port Configuration"

menu "Target Chip"

choice OHOS_TARGET_CHOICE
    prompt "ESP-IDF target chip"
    default OHOS_TARGET_ESP32
    help
      Select the ESP32-family chip target used by this project.
      The Makefile applies the selected target through idf.py set-target.

config OHOS_TARGET_ESP32
    bool "ESP32"
    help
      Select ESP32 Xtensa target.

config OHOS_TARGET_ESP32S3
    bool "ESP32-S3"
    help
      Select ESP32-S3 Xtensa LX7 target.

config OHOS_TARGET_ESP32C6
    bool "ESP32-C6"
    help
      Select ESP32-C6 RISC-V 32-bit target.

endchoice

config OHOS_IDF_TARGET
    string
    default "esp32" if OHOS_TARGET_ESP32
    default "esp32s3" if OHOS_TARGET_ESP32S3
    default "esp32c6" if OHOS_TARGET_ESP32C6

endmenu

menu "Yango Project To Run"

choice OHOS_PROJECT_CHOICE
    prompt "vendor/yango project to run"
    default OHOS_DEMO_GPIO_BLINK
    help
      Select which vendor/yango project will run after build and flash.

config OHOS_DEMO_GPIO_BLINK
    bool "vendor/yango/gpio_blink - GPIO blink"
    help
      Run the GPIO blink project.

config OHOS_DEMO_UART_ECHO
    bool "vendor/yango/uart_echo - UART echo"
    help
      Run the UART echo project.

config OHOS_DEMO_I2C_SCAN
    bool "vendor/yango/i2c_scan - I2C scan"
    help
      Run the I2C bus scan project.

config OHOS_DEMO_SPI_LOOP
    bool "vendor/yango/spi_loop - SPI loopback"
    help
      Run the SPI loopback project.

config OHOS_DEMO_WIFI_STA
    bool "vendor/yango/wifi_sta - Wi-Fi station"
    help
      Run the Wi-Fi station project.

config OHOS_DEMO_TCP_HTTP
    bool "vendor/yango/tcp_http - TCP and HTTP client"
    help
      Run the TCP/HTTP networking project.

endchoice

config OHOS_SELECTED_PROJECT
    string
    default "gpio_blink" if OHOS_DEMO_GPIO_BLINK
    default "uart_echo" if OHOS_DEMO_UART_ECHO
    default "i2c_scan" if OHOS_DEMO_I2C_SCAN
    default "spi_loop" if OHOS_DEMO_SPI_LOOP
    default "wifi_sta" if OHOS_DEMO_WIFI_STA
    default "tcp_http" if OHOS_DEMO_TCP_HTTP

endmenu
```

## Kconfig.projbuild
```kconfig
menu "Yango Vendor Projects"

choice OHOS_DEMO_SELECT
    prompt "Select vendor/yango project to run"
    default OHOS_DEMO_GPIO_BLINK

    config OHOS_DEMO_GPIO_BLINK
        bool "vendor/yango/gpio_blink - GPIO blink"

    config OHOS_DEMO_UART_ECHO
        bool "vendor/yango/uart_echo - UART echo"

    config OHOS_DEMO_I2C_SCAN
        bool "vendor/yango/i2c_scan - I2C scan"

    config OHOS_DEMO_SPI_LOOP
        bool "vendor/yango/spi_loop - SPI loopback"

    config OHOS_DEMO_WIFI_STA
        bool "vendor/yango/wifi_sta - Wi-Fi station"

    config OHOS_DEMO_TCP_HTTP
        bool "vendor/yango/tcp_http - TCP and HTTP client"
endchoice

config OHOS_TICK_HZ
    int "OpenHarmony tick rate"
    range 100 1000
    default 1000

config OHOS_DEMO_GPIO_PIN
    int "GPIO pin for blink project"
    default 2

config OHOS_DEMO_UART_PORT
    int "UART port for echo project"
    default 0

config OHOS_DEMO_I2C_PORT
    int "I2C port"
    default 0

config OHOS_DEMO_SPI_HOST
    int "SPI host"
    default 2

config OHOS_WIFI_SSID
    string "Wi-Fi SSID"
    default "ssid"

config OHOS_WIFI_PASS
    string "Wi-Fi password"
    default "password"

config OHOS_HTTP_URL
    string "HTTP URL"
    default "http://example.com/"

endmenu
```

## components/ohos_kernel_shim/Kconfig
```kconfig
menu "OHOS Kernel Shim"

config OHOS_SHIM_ENABLE
    bool "Enable lightweight OpenHarmony kernel shim"
    default y

endmenu
```

## components/ohos_port/Kconfig
```kconfig
menu "OHOS Port Layer"

config OHOS_PORT_ENABLE_TICK_TIMER
    bool "Enable timer-driven OHOS tick hook"
    default y

config OHOS_PORT_HEAP_FALLBACK_SIZE
    int "Fallback heap size in bytes"
    default 65536

config OHOS_PORT_LOG_BOOT_BANNER
    bool "Print OHOS boot banner"
    default y

endmenu
```

## sdkconfig.defaults
```kconfig
CONFIG_COMPILER_OPTIMIZATION_SIZE=y
CONFIG_LOG_DEFAULT_LEVEL_INFO=y
CONFIG_FREERTOS_HZ=1000
CONFIG_ESP_WIFI_ENABLED=y
CONFIG_LWIP_IPV4=y
```
